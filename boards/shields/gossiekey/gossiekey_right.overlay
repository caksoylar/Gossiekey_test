#include "gossiekey.dtsi" // Shared definitions between left and right

&kscan0 {
    row-gpios = <&gpio0 11 GPIO_ACTIVE_HIGH>,
                <&gpio1  6 GPIO_ACTIVE_HIGH>,
                <&gpio0 19 GPIO_ACTIVE_HIGH>,
                <&gpio0 21 GPIO_ACTIVE_HIGH>,
                <&gpio0 23 GPIO_ACTIVE_HIGH>,
                <&gpio0 12 GPIO_ACTIVE_HIGH>,
                <&gpio1  4 GPIO_ACTIVE_HIGH>;

    col-gpios = <&gpio0 17 (GPIO_PULL_DOWN | GPIO_ACTIVE_HIGH)>, // red
                <&gpio0 20 (GPIO_PULL_DOWN | GPIO_ACTIVE_HIGH)>, // yellow
                <&gpio0 22 (GPIO_PULL_DOWN | GPIO_ACTIVE_HIGH)>, // purple
                <&gpio0 24 (GPIO_PULL_DOWN | GPIO_ACTIVE_HIGH)>, // green
                <&gpio1  0 (GPIO_PULL_DOWN | GPIO_ACTIVE_HIGH)>; // black
};

// Offset of 5 because the left side has 5 columns
// (right side starts with RC(*, 5) in matrix transform)
&default_transform {
    col-offset = <5>;
};
